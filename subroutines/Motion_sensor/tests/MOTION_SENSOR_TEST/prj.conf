## CMakeLists.txt
```
# tests/MOTION_SENSOR_TEST/CMakeLists.txt

cmake_minimum_required(VERSION 3.20.0)
find_package(Zephyr REQUIRED HINTS $ENV{ZEPHYR_BASE})
project(motion_sensor_test)

# 添加你的 motion sensor 模块源码（让 ztest 能调用 imu_init / imu_update）
target_sources(app PRIVATE
    ${CMAKE_CURRENT_SOURCE_DIR}/../../src/imu.c
    ${CMAKE_CURRENT_SOURCE_DIR}/../../src/madgwick.c
)

# 包含头文件路径
target_include_directories(app PRIVATE
    ${CMAKE_CURRENT_SOURCE_DIR}/../../src
)
```

## prj.conf
```kconfig
CONFIG_ZTEST=y
CONFIG_ZTEST_NEW_API=y

# IMU sensor driver
CONFIG_SENSOR=y
CONFIG_LSM6DSO=y

CONFIG_LOG=y
CONFIG_LOG_DEFAULT_LEVEL=3
CONFIG_NEWLIB_LIBC=y
```

## src/main.c
```c
#include <zephyr/ztest.h>
#include <zephyr/kernel.h>
#include "imu.h"

ZTEST(motion_sensor, test_imu_init)
{
    int ret = imu_init();
    zassert_equal(ret, 0, "imu_init failed, ret=%d", ret);
}

ZTEST(motion_sensor, test_imu_update_valid)
{
    struct imu_angles ang;
    int ret = imu_update(&ang);
    zassert_equal(ret, 0, "imu_update failed");

    /* 检查 roll/pitch/yaw 是否是浮点数范围内 */
    zassert_true(ang.roll  > -360 && ang.roll  < 360, "roll invalid");
    zassert_true(ang.pitch > -360 && ang.pitch < 360, "pitch invalid");
    zassert_true(ang.yaw   > -360 && ang.yaw   < 360, "yaw invalid");
}

ZTEST_SUITE(motion_sensor, NULL, NULL, NULL, NULL, NULL);
```
