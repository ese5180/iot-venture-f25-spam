## subroutines/Motion_sensor/tests/MOTION_SENSOR_TEST/testcase.yaml
```yaml
tests:
  motion_logic.test:
    platform_allow: qemu_cortex_m3     # or comment this out and let Twister pick
    tags: motion unit
    harness: ztest
```

## subroutines/pressure_sensor/tests/PRESSURE_SENSOR_TEST/testcase.yaml
```yaml
tests:
  pressure_sensor.test:
    platform_allow: qemu_cortex_m3     # or comment this out and let Twister pick
    tags: pressure sensor
    harness: ztest
```

## subroutines/servo/tests/SERVO_UNIT_TEST/testcase.yaml
```yaml
tests:
  servo_logic.test:
    platform_allow: qemu_cortex_m3     # or comment this out and let Twister pick
    tags: servo unit
    harness: ztest
```
